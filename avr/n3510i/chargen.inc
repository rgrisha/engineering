.CSEG

;Autogenerated from lcd_chargen.c
; char  
char_20: .db 0x00,0x00,0x00,0x00,0x00,0x00
; char !
char_21: .db 0x21,0x08,0x42,0x00,0x80,0x00
; char "
char_22: .db 0x52,0x94,0x00,0x00,0x00,0x00
; char #
char_23: .db 0x52,0xBE,0xAF,0xA9,0x40,0x00
; char $
char_24: .db 0x23,0xA8,0xE2,0xB8,0x80,0x00
; char %
char_25: .db 0x4D,0x54,0x45,0x56,0x40,0x00
; char &
char_26: .db 0x45,0x28,0x8A,0xC9,0xA0,0x00
; char '
char_27: .db 0x21,0x08,0x00,0x00,0x00,0x00
; char (
char_28: .db 0x11,0x10,0x84,0x10,0x40,0x00
; char )
char_29: .db 0x41,0x04,0x21,0x11,0x00,0x00
; char *
char_2a: .db 0x04,0x55,0xF5,0x44,0x00,0x00
; char +
char_2b: .db 0x01,0x09,0xF2,0x10,0x00,0x00
; char ,
char_2c: .db 0x00,0x00,0x00,0x18,0x88,0x00
; char -
char_2d: .db 0x00,0x01,0xF0,0x00,0x00,0x00
; char .
char_2e: .db 0x00,0x00,0x00,0x11,0xC4,0x00
; char /
char_2f: .db 0x08,0x44,0x44,0x42,0x00,0x00
; char 0
char_30: .db 0x22,0xA3,0x18,0xA8,0x80,0x00
; char 1
char_31: .db 0x23,0x28,0x42,0x13,0xE0,0x00
; char 2
char_32: .db 0x74,0x42,0x64,0x43,0xE0,0x00
; char 3
char_33: .db 0xF8,0x44,0x60,0xC5,0xC0,0x00
; char 4
char_34: .db 0x11,0x95,0x2F,0x88,0x40,0x00
; char 5
char_35: .db 0xFC,0x2D,0x90,0xC5,0xC0,0x00
; char 6
char_36: .db 0x32,0x21,0x6C,0xC5,0xC0,0x00
; char 7
char_37: .db 0xF8,0x44,0x22,0x21,0x00,0x00
; char 8
char_38: .db 0x74,0x62,0xE8,0xC5,0xC0,0x00
; char 9
char_39: .db 0x74,0x66,0xD0,0x89,0x80,0x00
; char :
char_3a: .db 0x01,0x1C,0x40,0x11,0xC4,0x00
; char ;
char_3b: .db 0x01,0x1C,0x40,0x18,0x88,0x00
; char <
char_3c: .db 0x08,0x88,0x82,0x08,0x20,0x00
; char =
char_3d: .db 0x00,0x3E,0x0F,0x80,0x00,0x00
; char >
char_3e: .db 0x41,0x04,0x11,0x11,0x00,0x00
; char ?
char_3f: .db 0x74,0x44,0x42,0x00,0x80,0x00
; char @
char_40: .db 0x74,0x67,0x5B,0x41,0xC0,0x00
; char A
char_41: .db 0x22,0xA3,0x1F,0xC6,0x20,0x00
; char B
char_42: .db 0xF2,0x52,0xE4,0xA7,0xC0,0x00
; char C
char_43: .db 0x74,0x61,0x08,0x45,0xC0,0x00
; char D
char_44: .db 0xF2,0x52,0x94,0xA7,0xC0,0x00
; char E
char_45: .db 0xFC,0x21,0xE8,0x43,0xE0,0x00
; char F
char_46: .db 0xFC,0x21,0xE8,0x42,0x00,0x00
; char G
char_47: .db 0x74,0x61,0x09,0xC5,0xC0,0x00
; char H
char_48: .db 0x8C,0x63,0xF8,0xC6,0x20,0x00
; char I
char_49: .db 0x71,0x08,0x42,0x11,0xC0,0x00
; char J
char_4a: .db 0x38,0x84,0x21,0x49,0x80,0x00
; char K
char_4b: .db 0x8C,0xA9,0x8A,0x4A,0x20,0x00
; char L
char_4c: .db 0x84,0x21,0x08,0x43,0xE0,0x00
; char M
char_4d: .db 0x8C,0x77,0x58,0xC6,0x20,0x00
; char N
char_4e: .db 0x8C,0x73,0x59,0xC6,0x20,0x00
; char O
char_4f: .db 0x74,0x63,0x18,0xC5,0xC0,0x00
; char P
char_50: .db 0xF4,0x63,0xE8,0x42,0x00,0x00
; char Q
char_51: .db 0x74,0x63,0x18,0xD5,0xC1,0x00
; char R
char_52: .db 0xF4,0x63,0xEA,0x4A,0x20,0x00
; char S
char_53: .db 0x74,0x60,0xE0,0xC5,0xC0,0x00
; char T
char_54: .db 0xF9,0x08,0x42,0x10,0x80,0x00
; char U
char_55: .db 0x8C,0x63,0x18,0xC5,0xC0,0x00
; char V
char_56: .db 0x8C,0x62,0xA5,0x28,0x80,0x00
; char W
char_57: .db 0x8C,0x63,0x5A,0xEE,0x20,0x00
; char X
char_58: .db 0x8C,0x54,0x45,0x46,0x20,0x00
; char Y
char_59: .db 0x8C,0x54,0x42,0x10,0x80,0x00
; char Z
char_5a: .db 0xF8,0x44,0x44,0x43,0xE0,0x00
; char [
char_5b: .db 0x72,0x10,0x84,0x21,0xC0,0x00
; char \
char_5c: .db 0x84,0x10,0x41,0x04,0x20,0x00
; char ]
char_5d: .db 0x70,0x84,0x21,0x09,0xC0,0x00
; char ^
char_5e: .db 0x22,0xA2,0x00,0x00,0x00,0x00
; char _
char_5f: .db 0x00,0x00,0x00,0x00,0x1F,0x00
; char `
char_60: .db 0x20,0x80,0x00,0x00,0x00,0x00
; char a
char_61: .db 0x00,0x1C,0x17,0xC5,0xE0,0x00
; char b
char_62: .db 0x84,0x2D,0x98,0xE6,0xC0,0x00
; char c
char_63: .db 0x00,0x1D,0x18,0x45,0xC0,0x00
; char d
char_64: .db 0x08,0x5B,0x38,0xCD,0xA0,0x00
; char e
char_65: .db 0x00,0x1D,0x1F,0xC1,0xC0,0x00
; char f
char_66: .db 0x32,0x51,0xE4,0x21,0x00,0x00
; char g
char_67: .db 0x00,0x1F,0x18,0xBC,0x31,0x0E
; char h
char_68: .db 0x84,0x2D,0x98,0xC6,0x20,0x00
; char i
char_69: .db 0x20,0x18,0x42,0x11,0xC0,0x00
; char j
char_6a: .db 0x08,0x06,0x10,0x85,0x29,0x06
; char k
char_6b: .db 0x84,0x23,0x2E,0x4A,0x20,0x00
; char l
char_6c: .db 0x61,0x08,0x42,0x11,0xC0,0x00
; char m
char_6d: .db 0x00,0x35,0x5A,0xD6,0x20,0x00
; char n
char_6e: .db 0x00,0x2D,0x98,0xC6,0x20,0x00
; char o
char_6f: .db 0x00,0x1D,0x18,0xC5,0xC0,0x00
; char p
char_70: .db 0x00,0x2D,0x98,0xE6,0xD0,0x10
; char q
char_71: .db 0x00,0x1B,0x38,0xCD,0xA1,0x01
; char r
char_72: .db 0x00,0x2D,0x98,0x42,0x00,0x00
; char s
char_73: .db 0x00,0x1D,0x07,0x07,0xC0,0x00
; char t
char_74: .db 0x42,0x3C,0x84,0x24,0xC0,0x00
; char u
char_75: .db 0x00,0x23,0x18,0xCD,0xA0,0x00
; char v
char_76: .db 0x00,0x23,0x15,0x28,0x80,0x00
; char w
char_77: .db 0x00,0x23,0x1A,0xD5,0x40,0x00
; char x
char_78: .db 0x00,0x22,0xA2,0x2A,0x20,0x00
; char y
char_79: .db 0x00,0x23,0x19,0xB4,0x31,0x0E
; char z
char_7a: .db 0x00,0x3E,0x22,0x23,0xE0,0x00
; char {
char_7b: .db 0x19,0x04,0xC1,0x10,0x60,0x00
; char |
char_7c: .db 0x21,0x08,0x42,0x10,0x80,0x00
; char }
char_7d: .db 0x60,0x88,0x32,0x09,0x80,0x00
; char ~
char_7e: .db 0x4D,0x64,0x00,0x00,0x00,0x00
; char "smile"
char_7f: .db 0x00,0x14,0x08,0xB8,0x00,0x00


.equ char_width = 5
.equ char_height = 9
.equ bytes_per_char = 6

.equ char_cell_width = 7
.equ char_cell_height = 9

;r20 - pos x in char positions
;r21 - pos y in char positions
;r22 - backgruond color
;r23 - char color
;r24 - char code
put_char:
	push zh
	push zl
	push r0
	push r1
	push r25
	push r20
	push r21

	ldi r25, char_cell_width
	mul r20,r25
	mov r20,r0
	ldi r25, char_cell_height
	mul r21,r25
	mov r21,r0

	push r22
	push r23

	mov r22, r21
	ldi r21, char_cell_width
	ldi r23, char_cell_height

	;r20 - start x
	;r21 - width
	;r22 - start y
	;r23 - height
	rcall displ_set_cell

	pop r23
	pop r22

	ldi r25, 0x2C ; Write memory
	rcall displ_send_command 

	ldi zh, high( char_20 * 2   )
	ldi zl, low( char_20 * 2  )

	ldi r25,32
	sub r24,r25
	ldi r25, bytes_per_char
	mul r25,r24
	add zl,r0
	adc zh,r1

	ldi r25,1
	mov r1,r25
	ldi r20, char_width+1
	ldi r21, char_cell_height + 1

	mov r25, r22
	rcall displ_send_parameter 

	rjmp put_char_main_loop_skip_line_blanks

	put_char_main_loop:

	cpi r21,2
	breq put_char_main_loop_skip_line_blanks
	mov r25, r22
	rcall displ_send_parameter ; line ends with blank
	rcall displ_send_parameter ; next line starts with blank

	put_char_main_loop_skip_line_blanks:
	dec r21
	breq put_char_main_loop_end

	put_char_line_control:

	dec r20
	brne put_char_line_cont
	; line end, refresh x counter
	ldi r20, char_width +1
	rjmp put_char_main_loop

	put_char_line_cont:

	; byte control
	dec r1
	brne put_char_byte_ok
	lpm r0,Z+
	ldi r25, 8
	mov r1, r25
	put_char_byte_ok:
	; byte control end

	mov r25, r22
	sbrc r0,7
	mov r25, r23
	rcall displ_send_parameter 
	lsl r0

	rjmp put_char_line_control

	put_char_main_loop_end:

	mov r25, r22
	rcall displ_send_parameter 

	pop r21
	pop r20
	pop r25
	pop r1
	pop r0
	pop zl
	pop zh
	ret

.def reg_pos_x = r20
.def reg_pos_y = r21
;r20 - pos x in char positions
;r21 - pos y in char positions
;r22 - backgruond color
;r23 - char color
;r24 - hex char code
put_char_hex:  ; puts 2 hex chars one by one
	push r25
	push r19
	push r24

	ldi r19,2
	swap r24 ; higher nibble first

	put_hex_chars_loop_start: ; loop - 2 chars
	mov r25,r24
	andi r25,0x0F
	cpi r25,10
	brsh put_hex_chars_more_than_9
	subi r25,-1 * '0' ; addi is missing
	rjmp put_hex_chars_more_cont_1
	put_hex_chars_more_than_9:
	subi r25,( -1 * 'A' ) + 10
	put_hex_chars_more_cont_1:
	
	push r24
	mov r24,r25
	rcall put_char
	pop r24

	dec r19
	breq put_hex_chars_end
	swap r24
	inc r20
	rjmp put_hex_chars_loop_start

	put_hex_chars_end:

	pop r24
	pop r19
	pop r25
	ret
	
