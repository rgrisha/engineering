char_0: .db 0x00 0x00 0x00 0x00 0x00 0x00
char_1: .db 0x00 0x40 0x04 0x10 0x40 0x04
char_2: .db 0x00 0xa2 0x8a 0x00 0x00 0x00
char_3: .db 0x00 0xa2 0x9e 0x28 0xf2 0x8a
char_4: .db 0x00 0x42 0x94 0x38 0x52 0x84
char_5: .db 0x00 0x94 0x4a 0x10 0xa4 0x52
char_6: .db 0x00 0x84 0x14 0x20 0x54 0x8c
char_7: .db 0x00 0x40 0x04 0x00 0x00 0x00
char_8: .db 0x00 0x20 0x08 0x20 0x80 0x02
char_9: .db 0x00 0x80 0x02 0x08 0x20 0x08
char_a: .db 0x00 0x04 0x4a 0x7c 0xa4 0x40
char_b: .db 0x00 0x00 0x04 0x7c 0x40 0x00
char_c: .db 0x00 0x00 0x00 0x00 0x00 0x84
char_d: .db 0x00 0x00 0x00 0x7c 0x00 0x00
char_e: .db 0x00 0x00 0x00 0x00 0x00 0x0e
char_f: .db 0x00 0x10 0x42 0x10 0x84 0x10
char_10: .db 0x00 0x42 0x90 0x44 0x12 0x84
char_11: .db 0x00 0x42 0x14 0x10 0x40 0x1e
char_12: .db 0x00 0xe4 0x40 0x18 0x84 0x1e
char_13: .db 0x00 0xf0 0x42 0x18 0x14 0x4e
char_14: .db 0x00 0x20 0x8a 0x48 0xf0 0x82
char_15: .db 0x00 0xf4 0x16 0x64 0x14 0x4e
char_16: .db 0x00 0x62 0x10 0x58 0x94 0x4e
char_17: .db 0x00 0xf0 0x42 0x08 0x42 0x08
char_18: .db 0x00 0xe4 0x50 0x38 0x14 0x4e
char_19: .db 0x00 0xe4 0x52 0x34 0x10 0x8c
char_1a: .db 0x00 0x00 0x0e 0x10 0x00 0x0e
char_1b: .db 0x00 0x00 0x0e 0x10 0x00 0x84
char_1c: .db 0x00 0x10 0x84 0x20 0x40 0x80
char_1d: .db 0x00 0x00 0x1e 0x00 0xf0 0x00
char_1e: .db 0x00 0x80 0x02 0x04 0x20 0x08
char_1f: .db 0x00 0xe4 0x42 0x10 0x40 0x04
char_20: .db 0x00 0xe4 0x52 0x54 0x64 0x0e
char_21: .db 0x00 0x42 0x90 0x44 0xf4 0x50
char_22: .db 0x00 0xe2 0x48 0x38 0x92 0x5e
char_23: .db 0x00 0xe4 0x50 0x40 0x04 0x4e
char_24: .db 0x00 0xe2 0x48 0x24 0x92 0x5e
char_25: .db 0x00 0xf4 0x10 0x78 0x04 0x1e
char_26: .db 0x00 0xf4 0x10 0x78 0x04 0x10
char_27: .db 0x00 0xe4 0x50 0x40 0x34 0x4e
char_28: .db 0x00 0x14 0x50 0x7c 0x14 0x50
char_29: .db 0x00 0xe0 0x04 0x10 0x40 0x0e
char_2a: .db 0x00 0x70 0x82 0x08 0x24 0x8c
char_2b: .db 0x00 0x14 0x94 0x60 0x44 0x90
char_2c: .db 0x00 0x04 0x10 0x40 0x04 0x1e
char_2d: .db 0x00 0x14 0x5a 0x54 0x14 0x50
char_2e: .db 0x00 0x14 0x58 0x54 0x34 0x50
char_2f: .db 0x00 0xe4 0x50 0x44 0x14 0x4e
char_30: .db 0x00 0xe4 0x50 0x78 0x04 0x10
char_31: .db 0x00 0xe4 0x50 0x44 0x14 0x4e
char_32: .db 0x00 0xe4 0x50 0x78 0x44 0x90
char_33: .db 0x00 0xe4 0x50 0x38 0x14 0x4e
char_34: .db 0x00 0xf0 0x04 0x10 0x40 0x04
char_35: .db 0x00 0x14 0x50 0x44 0x14 0x4e
char_36: .db 0x00 0x14 0x50 0x28 0xa2 0x84
char_37: .db 0x00 0x14 0x50 0x54 0x56 0xd0
char_38: .db 0x00 0x14 0x4a 0x10 0xa4 0x50
char_39: .db 0x00 0x14 0x4a 0x10 0x40 0x04
char_3a: .db 0x00 0xf0 0x42 0x10 0x84 0x1e
char_3b: .db 0x00 0xe2 0x08 0x20 0x82 0x0e
char_3c: .db 0x00 0x04 0x08 0x10 0x20 0x40
char_3d: .db 0x00 0xe0 0x82 0x08 0x20 0x8e
char_3e: .db 0x00 0x42 0x90 0x00 0x00 0x00
char_3f: .db 0x00 0x00 0x00 0x00 0x00 0x00
char_40: .db 0x10 0x20 0x00 0x00 0x00 0x00
char_41: .db 0x00 0x00 0x0e 0x04 0xf4 0x4e
char_42: .db 0x00 0x04 0x16 0x64 0x16 0x56
char_43: .db 0x00 0x00 0x0e 0x44 0x04 0x4e
char_44: .db 0x00 0x10 0x4c 0x4c 0x14 0xcc
char_45: .db 0x00 0x00 0x0e 0x44 0xf4 0x0e
char_46: .db 0x00 0x62 0x48 0x78 0x82 0x08
char_47: .db 0x00 0x00 0x0e 0x44 0x12 0xc0
char_48: .db 0x00 0x04 0x16 0x64 0x14 0x50
char_49: .db 0x00 0x40 0x0c 0x10 0x40 0x0e
char_4a: .db 0x00 0x10 0x02 0x04 0x10 0x48
char_4b: .db 0x00 0x04 0x10 0x48 0xc4 0x90
char_4c: .db 0x00 0xc0 0x04 0x10 0x40 0x0e
char_4d: .db 0x00 0x00 0x1a 0x54 0x54 0x50
char_4e: .db 0x00 0x00 0x16 0x64 0x14 0x50
char_4f: .db 0x00 0x00 0x0e 0x44 0x14 0x4e
char_50: .db 0x00 0x00 0x16 0x64 0x16 0x56
char_51: .db 0x00 0x00 0x0c 0x4c 0x14 0xcc
char_52: .db 0x00 0x00 0x16 0x64 0x04 0x10
char_53: .db 0x00 0x00 0x0e 0x40 0xe0 0x5e
char_54: .db 0x00 0x82 0x1e 0x20 0x82 0x46
char_55: .db 0x00 0x00 0x10 0x44 0x14 0xcc
char_56: .db 0x00 0x00 0x10 0x44 0xa2 0x84
char_57: .db 0x00 0x00 0x10 0x44 0x54 0x4a
char_58: .db 0x00 0x00 0x10 0x28 0x42 0x90
char_59: .db 0x00 0x00 0x10 0x44 0x32 0x40
char_5a: .db 0x00 0x00 0x1e 0x08 0x42 0x1e
char_5b: .db 0x00 0x30 0x02 0x30 0x20 0x02
char_5c: .db 0x00 0x40 0x04 0x10 0x40 0x04
char_5d: .db 0x00 0xc0 0x84 0x0c 0x40 0x8c
char_5e: .db 0x00 0x94 0x52 0x00 0x00 0x00
char_5f: .db 0x00 0x00 0x0a 0x00 0x12 0x80
